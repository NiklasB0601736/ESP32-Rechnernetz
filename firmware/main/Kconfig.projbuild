## firmware/main/Kconfig.projbuild
```kconfig
menu "Funklabor"
config LAB_MASTER
    bool "Master / USB gateway (disable on slave)"
    default y
config LAB_NODE_ID
    int "Local node ID"
    range 1 65535
    default 1
config LAB_PEER_ID
    int "Allowed direct peer node ID"
    range 1 65535
    default 2
config LAB_PEER_MAC
    string "Allowed peer STA MAC (not Bluetooth or AP MAC)"
    default "00:00:00:00:00:00"
config LAB_CHANNEL
    int "Shared Wi-Fi channel"
    range 1 11
    default 6
endmenu
```

## firmware/sdkconfig.defaults
```kconfig
CONFIG_IDF_TARGET="esp32"
CONFIG_FREERTOS_HZ=1000
CONFIG_ESP_MAIN_TASK_STACK_SIZE=8192
CONFIG_ESP_CONSOLE_UART_DEFAULT=y
CONFIG_LOG_DEFAULT_LEVEL_WARN=y
CONFIG_LAB_NODE_ID=1
CONFIG_LAB_PEER_ID=2
CONFIG_LAB_MASTER=y
CONFIG_LAB_CHANNEL=6
```
